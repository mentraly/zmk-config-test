## boards/shields/nano2x2_dongle/Kconfig.defconfig
```kconfig
if SHIELD_NANO2X2_DONGLE

config ZMK_KEYBOARD_NAME
    default "OSU Ortho Dongle"

config ZMK_SPLIT
    default y

config ZMK_SPLIT_ROLE_CENTRAL
    default y

config ZMK_SPLIT_BLE_CENTRAL_PERIPHERALS
    default 1

endif
```

## boards/shields/nano2x2_dongle/Kconfig.shield
```kconfig
config SHIELD_NANO2X2_DONGLE
    def_bool $(shields_list_contains,nano2x2_dongle)
```

## config/west.yml
```yaml
manifest:
  defaults:
    revision: v0.3
  remotes:
    - name: badjeff
      url-base: https://github.com/badjeff
    - name: nrfconnect
      url-base: https://github.com/nrfconnect
    - name: zmkfirmware
      url-base: https://github.com/zmkfirmware
    # Additional modules containing boards/shields/custom code can be listed here as well
    # See https://docs.zephyrproject.org/3.2.0/develop/west/manifest.html#projects
  projects:
    - name: zmk-feature-split-esb
      remote: badjeff
      revision: main
    - name: sdk-nrf
      remote: badjeff
      revision: v3.1-branch+zmk-fixes
      path: nrf
    - name: nrfxlib
      remote: nrfconnect
      revision: v3.1-branch
      repo-path: sdk-nrfxlib
      path: nrfxlib
    - name: zmk
      remote: zmkfirmware
      revision: main
      import: app/west.yml
  self:
    path: config
```
